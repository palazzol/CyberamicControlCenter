
        .area   region1 (ABS)

        .include "../../include/ptt6502.def"

        .org    0x1000

L1000:
        brk
        lda     U18_edge_detect_control_DI_pos
        lda     U19_edge_detect_control_DI_pos
        lda     #0x7D
        sta     U18_1D
        lda     0x50
        beq     L1012
        dec     0x50


L1012:
        lda     0x51
        beq     L1018
        dec     0x51


L1018:
        lda     0x52
        beq     L101E
        dec     0x52


L101E:
        dec     0x53
        bne     L1046
        lda     #0x64
        sta     0x53
        lda     0x54
        beq     L102C
        dec     0x54


L102C:
        lda     0x64
        beq     L1032
        dec     0x64


L1032:
        lda     0x55
        beq     L1038
        dec     0x55


L1038:
        dec     0x56
        bne     L1046
        lda     #0x64
        sta     0x56
        lda     0x57
        beq     L1046
        dec     0x57


L1046:
        pla
        rti

L1048:
        cld
        sei
        ldx     #0xF0
        txs
        lda     #0x00
        ldx     #0x10


L1051:
        sta     0x00,x
        inx
        cpx     #0x80
        bne     L1051
        lda     #0x00
        sta     transport_control_reg_a
        sta     transport_periph$ddr_reg_a
        sta     audio_control_reg_a
        sta     audio_periph$ddr_reg_a
        sta     audio_control_reg_b
        sta     U18_edge_detect_control_DI_pos
        sta     transport_control_reg_b
        sta     U18_06
        sta     U19_06
        sta     U18_DDRA
        lda     #0x02
        sta     U19_DDRA
        lda     #0xFF
        sta     audio_periph$ddr_reg_b
        sta     U18_DDRB
        sta     U19_DDRB
        lda     #0xFC
        sta     transport_periph$ddr_reg_b
        lda     #0x2E
        sta     transport_control_reg_a
        sta     transport_control_reg_b
        lda     #0x3C
        sta     audio_control_reg_a
        sta     audio_control_reg_b
        cli
        sta     U18_1C
        lda     #0x64
        sta     0x53
        lda     #0x18
        sta     0x57
        lda     #0x64
        sta     0x56
        lda     #0x0A
        sta     0x62
        lda     #0x09
        sta     UART_02
        lda     #0x10
        jsr     L122E
        lda     #0x28
        sta     0x54
        lda     #0x64
        sta     0x53


L10C3:
        lda     0x54
        bne     L10C3
        jsr     L11FB


L10CA:
        lda     #0xFA
        sta     0x64
        lda     #0x00
        sta     0x65
        sta     0x66
        lda     #0x30
        lda     #0x40
        jsr     L122E


L10DB:
        lda     #0x00
        sta     0x58


L10DF:
        lda     transport_periph$ddr_reg_b
        lda     #0x0A
        sta     0x50
        inc     0x58
        lda     0x58
        cmp     #0x64
        bcs     L10FD


L10EE:
        jsr     L13ED
        lda     0x50
        beq     L10DB
        lda     transport_control_reg_b
        bpl     L10EE
        jmp     L10DF


L10FD:
        lda     #0x20
        jsr     L1200
        lda     #0x19
        sta     0x54
        lda     #0x64
        sta     0x53


L110A:
        jsr     L13ED
        lda     0x54
        bne     L110A
        lda     #0x00
        sta     0x59
        jsr     L1249
        lda     #0x40
        jsr     L122E
        jsr     L1249
        lda     #0xFA
        sta     0x50


L1124:
        jsr     L13ED
        lda     0x50
        bne     L1124
        lda     #0x20
        jsr     L122E
        jsr     L1249
        inc     0x59
        lda     #0x10
        jsr     L122E
        lda     #0x80
        jsr     L122E
        jsr     L126C
        lda     #0x10
        jsr     L122E


L1147:
        lda     #0x5E
        sta     0x69
        lda     #0x13
        sta     0x6A
        jsr     L13A9
        jsr     L13ED
        jsr     L12D3
        lda     UART_02
        and     #0x05
        beq     L1182
        lda     0x67
        bne     L116F
        lda     UART_01
        cmp     #0x53
        bne     L1182
        inc     0x67
        jmp     L1182


L116F:
        lda     #0x00
        sta     0x67
        lda     UART_01
        cmp     #0x31
        beq     L11B0
        cmp     #0x32
        beq     L1188
        cmp     #0x33
        beq     L119D


L1182:
        jmp     L1147
        jmp     L10CA


L1188:
        lda     #0xFF
        sta     0x00
        .byte   0xFF,0xFF,0xFF,0xFF,0xFF,0xFF,0xFF,0xFF,0xFF,0xFF,0xFF,0xFF,0xFF,0xFF,0xFF,0xFF
        .byte   0xFF

L119D:
        .byte   0xFF,0xFF,0xFF,0xFF,0xFF,0xFF,0xFF,0xFF,0xFF,0xFF,0xFF,0xFF,0xFF,0xFF,0xFF,0xFF
        .byte   0xFF,0xFF,0xFF

L11B0:
        .byte   0xFF,0xFF,0xFF,0xFF,0xFF,0xFF,0xFF,0xFF,0xFF,0xFF,0xFF,0xFF,0xFF,0xFF,0xFF,0xFF
        .byte   0xFF,0xFF,0xFF,0xFF,0xFF,0xFF,0xFF,0xFF,0xFF,0xFF,0xFF,0xFF,0xFF,0xFF,0xFF,0xFF
        .byte   0xFF,0xFF,0xFF,0xFF,0xFF,0xFF,0xFF,0xFF,0xFF,0xFF,0xFF,0xFF,0xFF,0xFF,0xFF,0xFF
        .byte   0xFF,0xFF,0xFF,0xFF,0xFF,0xFF,0xFF,0xFF,0xFF,0xFF,0xFF,0xFF,0xFF,0xFF,0xFF,0xFF
        .byte   0xFF,0xFF,0xFF,0xFF,0xFF,0xFF,0xFF,0xFF,0xFF,0xFF,0xFF

L11FB:
        .byte   0xFF,0xFF,0xFF,0xFF,0xFF

L1200:
        .byte   0xFF,0xFF,0xFF,0xFF,0xFF,0xFF,0xFF,0xFF,0xFF,0xFF,0xFF,0xFF,0xFF,0xFF,0xFF,0xFF
        .byte   0xFF,0xFF,0xFF,0xFF,0xFF,0xFF,0xFF,0xFF,0xFF,0xFF,0xFF,0xFF,0xFF,0xFF,0xFF,0xFF
        .byte   0xFF,0xFF,0xFF,0xFF,0xFF,0xFF,0xFF,0xFF,0xFF,0xFF,0xFF,0xFF,0xFF,0xFF

L122E:
        .byte   0xFF,0xFF,0xFF,0xFF,0xFF,0xFF,0xFF,0xFF,0xFF,0xFF,0xFF,0xFF,0xFF,0xFF,0xFF,0xFF
        .byte   0xFF,0xFF,0xFF,0xFF,0xFF,0xFF,0xFF,0xFF,0xFF,0xFF,0xFF

L1249:
        .byte   0xFF,0xFF,0xFF,0xFF,0xFF,0xFF,0xFF,0xFF,0xFF,0xFF,0xFF,0xFF,0xFF,0xFF,0xFF,0xFF
        .byte   0xFF,0xFF,0xFF,0xFF,0xFF,0xFF,0xFF,0xFF,0xFF,0xFF,0xFF,0xFF,0xFF,0xFF,0xFF,0xFF
        .byte   0xFF,0xFF,0xFF

L126C:
        .byte   0xFF,0xFF,0xFF,0xFF,0xFF,0xFF,0xFF,0xFF,0xFF,0xFF,0xFF,0xFF,0xFF,0xFF,0xFF,0xFF
        .byte   0xFF,0xFF,0xFF,0xFF,0xFF,0xFF,0xFF,0xFF,0xFF,0xFF,0xFF,0xFF,0xFF,0xFF,0xFF,0xFF
        .byte   0xFF,0xFF,0xFF,0xFF,0xFF,0xFF,0xFF,0xFF,0xFF,0xFF,0xFF,0xFF,0xFF,0xFF,0xFF,0xFF
        .byte   0xFF,0xFF,0xFF,0xFF,0xFF,0xFF,0xFF,0xFF,0xFF,0xFF,0xFF,0xFF,0xFF,0xFF,0xFF,0xFF
        .byte   0xFF,0xFF,0xFF,0xFF,0xFF,0xFF,0xFF,0xFF,0xFF,0xFF,0xFF,0xFF,0xFF,0xFF,0xFF,0xFF
        .byte   0xFF,0xFF,0xFF,0xFF,0xFF,0xFF,0xFF,0xFF,0xFF,0xFF,0xFF,0xFF,0xFF,0xFF,0xFF,0xFF
        .byte   0xFF,0xFF,0xFF,0xFF,0xFF,0xFF,0xFF

L12D3:
        .byte   0xFF,0xFF,0xFF,0xFF,0xFF,0xFF,0xFF,0xFF,0xFF,0xFF,0xFF,0xFF,0xFF,0xFF,0xFF,0xFF
        .byte   0xFF,0xFF,0xFF,0xFF,0xFF,0xFF,0xFF,0xFF,0xFF,0xFF,0xFF,0xFF,0xFF,0xFF,0xFF,0xFF
        .byte   0xFF,0xFF,0xFF,0xFF,0xFF,0xFF,0xFF,0xFF,0xFF,0xFF,0xFF,0xFF,0xFF,0xFF,0xFF,0xFF
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        .byte   0xFF,0xFF,0xFF,0xFF,0xFF,0xFF

L13A9:
        .byte   0xFF,0xFF,0xFF,0xFF,0xFF,0xFF,0xFF,0xFF,0xFF,0xFF,0xFF,0xFF,0xFF,0xFF,0xFF,0xFF
        .byte   0xFF,0xFF,0xFF,0xFF,0xFF,0xFF,0xFF,0xFF,0xFF,0xFF,0xFF,0xFF,0xFF,0xFF,0xFF,0xFF
        .byte   0xFF,0xFF,0xFF,0xFF,0xFF,0xFF,0xFF,0xFF,0xFF,0xFF,0xFF,0xFF,0xFF,0xFF,0xFF,0xFF
        .byte   0xFF,0xFF,0xFF,0xFF,0xFF,0xFF,0xFF,0xFF,0xFF,0xFF,0xFF,0xFF,0xFF,0xFF,0xFF,0xFF
        .byte   0xFF,0xFF,0xFF,0xFF

L13ED:
        .byte   0xFF,0xFF,0xFF,0xFF,0xFF,0xFF,0xFF,0xFF,0xFF,0xFF,0xFF,0xFF,0xFF,0xFF,0xFF,0xFF
        .byte   0xFF,0xFF,0xFF,0xFF,0xFF,0xFF,0xFF,0xFF,0xFF,0xFF,0xFF,0xFF,0xFF,0xFF,0xFF,0xFF
        .byte   0xFF,0xFF,0xFF,0xFF,0xFF,0xFF,0xFF,0xFF,0xFF,0xFF,0xFF,0xFF,0xFF,0xFF,0xFF,0xFF
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        .byte   0xFF,0xFF,0xFF